## config/boards/shields/ergos/Kconfig.defconfig
```kconfig
if SHIELD_ERGOS_LEFT

config ZMK_KEYBOARD_NAME
    default "Ergo-S L"

config ZMK_SPLIT_BLE_ROLE_CENTRAL
    default y
endif

if SHIELD_ERGOS_RIGHT

config ZMK_KEYBOARD_NAME
    default "Ergo-S R"
endif

if SHIELD_ERGOS_LEFT || SHIELD_ERGOS_RIGHT

config ZMK_SPLIT
    default y
endif
```

## config/boards/shields/ergos/Kconfig.shield
```kconfig
config SHIELD_ERGOS_LEFT
    def_bool $(shields_list_contains,ergos_left)

config SHIELD_ERGOS_RIGHT
    def_bool $(shields_list_contains,ergos_right)
```
