#include "dac_man_5x6.dtsi"

&default_transform {
    col-offset = <0>;
};

&kscan0 {
    col-gpios
        = <&pro_micro_d 19 GPIO_ACTIVE_HIGH>
        , <&pro_micro_d 18 GPIO_ACTIVE_HIGH>
        , <&pro_micro_d 15 GPIO_ACTIVE_HIGH>
        , <&pro_micro_d 14 GPIO_ACTIVE_HIGH>
        , <&pro_micro_d 16 GPIO_ACTIVE_HIGH>
        , <&pro_micro_d 10 GPIO_ACTIVE_HIGH>
        , <&pro_micro_d 9 GPIO_ACTIVE_HIGH>
        , <&pro_micro_d 8 GPIO_ACTIVE_HIGH>
        ;
};
